## config/west.yml
```yaml
manifest:
  remotes:
    - name: zmkfirmware
      url-base: https://github.com/zmkfirmware
    - name: cormoran
      url-base: https://github.com/cormoran
    # 既存のリモートはそのまま維持
    - name: takamaru-fpv  # <-- Battery level smoothing
      url-base: https://github.com/takamaru-fpv
  projects:
#    - name: zmk
#      remote: zmkfirmware
#      revision: main
#      import: app/west.yml

    # ZMK: DYA Studio 用カスタム RPC サブシステム付き cormoran fork
    - name: zmk
      remote: cormoran
#      revision: v0.3-branch+dya
      revision: e5c9b6915b56801193e359dd9bad4a167ce0d1b8
#      revision: main
      import: app/west.yml

    # DYA Studio モジュール（すべて cormoran リポジトリ）
    - name: zmk-module-ble-management
      remote: cormoran
      revision: main
    - name: zmk-module-battery-history
      remote: cormoran
      revision: main
    - name: zmk-module-settings-rpc
      remote: cormoran
      revision: main
    - name: zmk-module-runtime-input-processor
      remote: cormoran
      revision: main

    # or latest commit hash
    # Below setting required to use unofficial studio custom RPC feature
    # Persistent settings storage backend used by this module
    - name: zmk-feature-custom-settings
      remote: cormoran
      revision: main

    - name: zmk-feature-runtime-macro
      remote: cormoran
      revision: main
    - name: zmk-feature-runtime-combo
      remote: cormoran
      revision: main

    - name: zmk-feature-input-stream # 押下キー表示が必要な場合だけ
      remote: cormoran
      revision: main
    - name: zmk-feature-module-physical-layout # プレビューに拡張モジュールを表示する場合だけ
      remote: cormoran
      revision: main


  self:
    path: config
```
